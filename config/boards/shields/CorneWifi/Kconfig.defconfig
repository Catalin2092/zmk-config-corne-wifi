## config/boards/shields/CorneWifi/Kconfig.defconfig
```kconfig
if SHIELD_CORNEWIFI_LEFT

config ZMK_KEYBOARD_NAME
    default "CorneWifi"

config ZMK_SPLIT_ROLE_CENTRAL
    default y

endif

if SHIELD_CORNEWIFI_LEFT || SHIELD_CORNEWIFI_RIGHT

config ZMK_SPLIT
    default y

if ZMK_DISPLAY

config I2C
    default y

config SSD1306
    default y

endif # ZMK_DISPLAY

endif
```

## config/boards/shields/CorneWifi/Kconfig.shield
```kconfig
config SHIELD_CORNEWIFI_LEFT
    def_bool $(shields_list_contains,CorneWifi_left)

config SHIELD_CORNEWIFI_RIGHT
    def_bool $(shields_list_contains,CorneWifi_right)
    
```

## config/boards/shields/cornewifi/Kconfig.defconfig
```kconfig
if SHIELD_CORNEWIFI_LEFT

config ZMK_KEYBOARD_NAME
    default "Corne_Wifi"

config ZMK_SPLIT_ROLE_CENTRAL
    default y

endif

if SHIELD_CORNEWIFI_LEFT || SHIELD_CORNEWIFI_RIGHT

config ZMK_SPLIT
    default y

if ZMK_DISPLAY

config I2C
    default y

config SSD1306
    default y

endif # ZMK_DISPLAY

endif

CONFIG_BT_DIS_MODEL="Corne_Wifi"
```

## config/boards/shields/cornewifi_2/Kconfig.shield
```kconfig
config SHIELD_CORNEWIFI_LEFT
    def_bool $(shields_list_contains,cornewifi_left)

config SHIELD_CORNEWIFI_RIGHT
    def_bool $(shields_list_contains,cornewifi_right)
    
```
